## package/v4l2grab/Config.in
```kconfig
config BR2_PACKAGE_V4L2GRAB
	bool "v4l2grab"
	# dependencies from lib4l
	depends on BR2_TOOLCHAIN_HAS_THREADS
	depends on BR2_USE_MMU # fork()
	depends on !BR2_STATIC_LIBS # dlopen()
	depends on BR2_INSTALL_LIBSTDCPP
	depends on BR2_TOOLCHAIN_HEADERS_AT_LEAST_3_0 # media headers
	# wait for libv4l 1.7+ for musl compatibility
	depends on BR2_TOOLCHAIN_USES_GLIBC || BR2_TOOLCHAIN_USES_UCLIBC
	select BR2_PACKAGE_JPEG
	select BR2_PACKAGE_LIBV4L
	help
	  Utility for grabbing JPEGs form V4L2 devices.

	  http://www.twam.info/software/v4l2grab-grabbing-jpegs-from-v4l2-devices
```
